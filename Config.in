## Config.in
```kconfig
source "$BR2_EXTERNAL_BUILDROOT_RASPBERRYPI_PATH/package/wifi-rtl8831bu/Config.in"
```

## package/wifi-rtl8831bu/Config.in
```kconfig
config BR2_PACKAGE_WIFI_RTL8831BU
	bool "wifi-rtl8831bu"
	depends on BR2_LINUX_KERNEL
	select BR2_PACKAGE_LINUX_FIRMWARE
	select BR2_PACKAGE_LINUX_FIRMWARE_RTL_RTW89
```
